#include <Wire.h>
#include <Adafruit_GFX.h>
#include <Adafruit_SSD1306.h>
#include <Servo.h>
Servo myservo;


#define ECHO_PIN 4
#define TRIG_PIN 5

#define left_A   3 // definisce la velocità del motore sinistro al PIN 3
#define right_B 11 // definisce la velocità del motore sinistro al PIN 11
#define INT_A   12 // controlla la direzione del motore sinistro sul PIN 12
#define INT_B   13 // controlla la direzione del motore destro sul PIN 13

#define SCREEN_WIDTH 128 
#define SCREEN_HEIGHT 64
#define OLED_RESET    18
Adafruit_SSD1306 display(SCREEN_WIDTH, SCREEN_HEIGHT, &Wire, OLED_RESET);

const unsigned char logo [] PROGMEM = {
  0x00, 0x00, 0x00, 0x00, 0x00, 0x00, 0x00, 0x00, 0x00, 0x00, 0x00, 0x00, 0x00, 0x00, 0x00, 0x00, 
  0x00, 0x00, 0x00, 0x00, 0x00, 0x00, 0x00, 0x00, 0x00, 0x00, 0x00, 0x00, 0x00, 0x00, 0x00, 0x00, 
  0x00, 0x00, 0x00, 0x00, 0x00, 0x00, 0x00, 0x00, 0x00, 0x00, 0x00, 0x00, 0x00, 0x00, 0x00, 0x00, 
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  0x00, 0x00, 0x00, 0x00, 0x00, 0x00, 0x00, 0x00, 0x00, 0x00, 0x00, 0x00, 0x00, 0x00, 0x00, 0x00
};


const int dist_min = 30;
int sound, lumen, sensorIR, rDistance, lDistance, mDistance;
double distanceCm;

void setup() {
  pinMode (ECHO_PIN, INPUT);
  pinMode (TRIG_PIN, OUTPUT);
  pinMode (left_A, OUTPUT);
  pinMode (right_B, OUTPUT);
  pinMode (INT_A, OUTPUT);
  pinMode (INT_B, OUTPUT);
  pinMode (7, INPUT);
  pinMode (8, OUTPUT);
  pinMode (9, OUTPUT);
  pinMode (10, OUTPUT);
  pinMode (16, INPUT);


  myservo.attach(6);
  
  Serial.begin(9600);
 
 display.begin(SSD1306_SWITCHCAPVCC, 0x3C);

 display.clearDisplay();
 display.drawBitmap (0, 0, logo, 128, 64, 1);
 display.display();

 delay(1000);
 
 display.setTextSize(2);
 display.setTextColor(1,0);
 display.setCursor(10, 50);
 display.println("RESHITOZE");
 display.display();

 delay(3000);

 
}

void loop() {
myservo.write(90); 
 
mDistance = distance();

ultra();

sensorIR = digitalRead (7);

if (sensorIR == 0){
  Stop();
  delay (500);
  ultra();
  
  }

}

void ultra(){


  if (mDistance < dist_min) {
      Stop();
      delay(500);                 
      myservo.write(30);          
      delay(1000);      
      rDistance = distance();
      
      delay(500);
      myservo.write(90);              
      delay(1000);                                                  
      myservo.write(150);              
      delay(1000); 
      lDistance = distance();
      
      delay(500);
      myservo.write(90);              
      delay(1000);
      if(rDistance > lDistance) {
        Right();
        delay(360);
      }
      else if(rDistance < lDistance) {
        Left();
        delay(360);
      }
      else if((rDistance <= dist_min) || (lDistance <= dist_min)) {
        Back();
        delay(180);
      }
      else {
        Go();

      }
    }  
    else {
        Go();

    }                     


}

// Misurazione Distanza con Ultrasuoni
int distance(){
  digitalWrite(TRIG_PIN, LOW); 
  delayMicroseconds(2); 
  digitalWrite(TRIG_PIN, HIGH); 
  delayMicroseconds(10);
  digitalWrite(TRIG_PIN, LOW);
  unsigned long impulso = pulseIn(ECHO_PIN,HIGH); 
  distanceCm = impulso / 2.0 * 0.0343;
  return (int)distanceCm;
  
  }

// funzione per fermarsi
void Stop()
{
digitalWrite (INT_A, LOW);
digitalWrite (INT_B, LOW);
analogWrite (left_A, 0); 
analogWrite (right_B, 0);

light();
clap();
   
 display.clearDisplay();
 display.setTextSize(1);
 display.setTextColor(1);
 display.setCursor(0, 5);
 display.println("Tank:");
 display.setTextSize(3);
 display.setTextColor(1);
 display.setCursor(0, 20);
 display.println("STOP");
 display.display();
      

}

// funzione per girare a destra
void Right()
{
digitalWrite(INT_A,LOW);
digitalWrite(INT_B,HIGH);
analogWrite(left_A,255);
analogWrite(right_B,255);

light();
clap();

 display.clearDisplay();
 display.setTextSize(1);
 display.setTextColor(1);
 display.setCursor(0, 5);
 display.println("Tank:");
 display.setTextSize(3);
 display.setTextColor(1);
 display.setCursor(0, 20);
 display.println("DESTRA");
 display.display();


}

// funzione per girare a sinistra
void Left()
{
digitalWrite(INT_A,HIGH);
digitalWrite(INT_B,LOW);
analogWrite(left_A,255);
analogWrite(right_B,255);

light();
clap();

 display.clearDisplay();
 display.setTextSize(1);
 display.setTextColor(1);
 display.setCursor(0, 5);
 display.println("Tank:");
 display.setTextSize(3);
 display.setTextColor(1);
 display.setCursor(0, 20);
 display.println("SINISTRA");
 display.display();

}

// funzione per retromarcia
void Back()
{
digitalWrite(INT_A,LOW);
digitalWrite(INT_B,LOW);
analogWrite(left_A,255);
analogWrite(right_B,255);

light();
clap();


sensorIR = digitalRead (7);
if (sensorIR == 0){
  Stop();
  delay (500);
  ultra();
  
  }

 display.clearDisplay();
 display.setTextSize(1);
 display.setTextColor(1);
 display.setCursor(0, 5);
 display.println("Tank:");
 display.setTextSize(3);
 display.setTextColor(1);
 display.setCursor(0, 20);
 display.println("INDIETRO");
 display.display();


}

// funzione per andare avanti
void Go()
{
digitalWrite(INT_A,HIGH);
digitalWrite(INT_B,HIGH);
analogWrite(left_A,255);
analogWrite(right_B,255);

light();
clap();

 display.clearDisplay();
 display.setTextSize(1);
 display.setTextColor(1);
 display.setCursor(0, 5);
 display.println("Tank:");
 display.setTextSize(3);
 display.setTextColor(1);
 display.setCursor(0, 20);
 display.println("AVANTI");
 display.display();

}

void light(){
  lumen = analogRead(A3);
  if (lumen > 400) {
    digitalWrite(10, HIGH);
    digitalWrite(8, HIGH);
    digitalWrite(9, HIGH);
  }
else {
    digitalWrite(10, LOW);
    digitalWrite(8, LOW);
    digitalWrite(9, LOW);
  }

Serial.print("Luce ");
Serial.println(lumen);
  }

void clap(){
  sound = digitalRead(16);
  if (sound == 1) {
    digitalWrite(10, HIGH);
    digitalWrite(8, HIGH);
    digitalWrite(9, HIGH);
    
 display.clearDisplay();
 display.setTextSize(1);
 display.setTextColor(1);
 display.setCursor(0, 5);
 display.println("Tank:");
 display.setTextSize(3);
 display.setTextColor(1);
 display.setCursor(0, 20);
 display.println("PAURA");
 display.display();
 
   delay(2000);
    Stop();
    Back();
    delay (3000);   
  }
  else {    
  }

  Serial.print("Clap ");
  Serial.println(sound);
  }
